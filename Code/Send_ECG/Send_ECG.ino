// Simuler l'envoie de valeurs pour le projet ECG
// Signal provenant du site : https://www.physionet.org/physiobank/database/
#define FREQ 60
#define NB_MAX 400 // Nombre d'échantillons
#define T_MAX 1108  // Temps max en ms
#define DELAY 1000/FREQ

const uint16_t t_t[] = {0, 3, 6, 8, 11, 14, 17, 19, 22, 25, 28, 31, 33,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 1106, 1108};
const int16_t v_LII[] = {390, 380, 390, 360, 360, 370, 420, 410, 390, 380, 380, 390, 390,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 670, 660};
const int16_t v_LV[] = {0};// = {500, 520, 480, 450, 440, 480, 510, 490, 500, 470, 490, 470, 490,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 210, 250};

uint32_t t_ref;

double getECG(uint32_t t, bool table = 0) {
  uint16_t index = 0;
  if (t <= T_MAX);
  else t = t % (T_MAX + 1);

  while (t_t[index + 1] < t) index++;
  if (t_t[index] == t)  {
    if (table) return v_LII[index];
    else return v_LV[index];
  }
  
  else  {
    // Serial.print("Else (index): " + (String) index);
    if (!table) return (double) v_LII[index] + (float) (v_LII[index + 1] - v_LII[index]) / (float) (t_t[index + 1] - t_t[index]) * (float) (t - t_t[index]) ;
    else return (double) (v_LV[index] + (float) (v_LV[index + 1] - v_LV[index]) / (float) (t_t[index + 1] - t_t[index])) * (float) (t - t_t[index]) ;
  }
}

void setup() {
  Serial.begin(19200);
  t_ref = millis();
}

void loop() {
  if (millis() - t_ref < DELAY);
  else  {
    t_ref = millis();
    Serial.println("Extrnl " + (String) getECG(millis()) + " mV");
  }
}
